## boards/shields/mokes_left_only/Kconfig.shield
```kconfig
config SHIELD_MOKES_LEFT_ONLY
    def_bool $(shields_list_contains,mokes_left_only)
```

## boards/shields/mokulua/Kconfig.defconfig
```kconfig
if SHIELD_MOKULUA_LEFT

config ZMK_KEYBOARD_NAME
    default "mokulua"

config ZMK_SPLIT_ROLE_CENTRAL
    default y

endif # SHIELD_MOKULUA_LEFT

if SHIELD_MOKULUA_LEFT || SHIELD_MOKULUA_RIGHT

config ZMK_SPLIT
    default y

endif # SHIELD_MOKULUA_LEFT || SHIELD_MOKULUA_RIGHT
```
